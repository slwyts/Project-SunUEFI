// SPDX-License-Identifier: GPL-2.0-only OR BSD-2-Clause
/dts-v1/;
/plugin/;

/* Match the factory rear sensor mode tables and their CSI PLL. The clock
 * provider already supplies 19.2 MHz from TCXO without the 24 MHz PLL.
 */
/ {
	fragment@0 {
		target-path = "/soc/cci-ml@ac7b000/i2c-bus@1/camera@10";
		__overlay__ {
			assigned-clock-rates = <19200000>;
		};
	};

	fragment@1 {
		target-path = "/soc/cci-ml@ac7b000/i2c-bus@1/camera@10/port/endpoint";
		__overlay__ {
			link-frequencies = /bits/ 64 <857600000>;
		};
	};

	fragment@2 {
		target-path = "/soc/clock-controller-ml@1760000";
		__overlay__ {
			/* MCLK outputs require Titan top as well as MMCX=6 and MX=8.
			 * The clock provider holds these domains while prepared.
			 */
			power-domains = <&rpmhpd_ml 6>, <&rpmhpd_ml 8>,
					<&camcc_ml 0>;
		};
	};

	fragment@3 {
		target-path = "/soc/cci-ml@ac7b000/i2c-bus@1/vcm@c";
		__overlay__ {
			compatible = "giantec,gt9764ba";
		};
	};
};
