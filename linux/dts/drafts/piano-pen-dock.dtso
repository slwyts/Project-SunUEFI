// SPDX-License-Identifier: GPL-2.0-only OR BSD-2-Clause
/dts-v1/;
/plugin/;

#include <dt-bindings/gpio/gpio.h>

/*
 * Ordinary Hall3/Hall4 path, from the Piano final Android DT and SC96231
 * driver. This is a GPIO input device, independent of the charger I2C bus.
 * Do not combine this path with PPE or claim wireless charging support.
 * Disabled until the pen model/path and physical transitions are verified.
 * Normal GPIO acquisition takes AP ownership, as the factory qcom,apps
 * input states do. The legacy `tlmm` symbol points at the old provider;
 * piano_tlmm_ml names the real mainline SM8750 TLMM instance.
 */
/ {
	fragment@0 {
		target = <&piano_tlmm_ml>;
		__overlay__ {
			piano_pen_dock_default: pen-dock-default-state {
				pins = "gpio200", "gpio196";
				function = "gpio";
				drive-strength = <2>;
				bias-pull-up;
				input-enable;
			};
		};
	};

	fragment@1 {
		target-path = "/soc";
		__overlay__ {
			pen-dock {
				compatible = "xiaomi,piano-pen-dock";
				pinctrl-names = "default";
				pinctrl-0 = <&piano_pen_dock_default>;
				hall-gpios = <&piano_tlmm_ml 200 GPIO_ACTIVE_LOW>,
					     <&piano_tlmm_ml 196 GPIO_ACTIVE_LOW>;
				status = "disabled";
			};
		};
	};
};
